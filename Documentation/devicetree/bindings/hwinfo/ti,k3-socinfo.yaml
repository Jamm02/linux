## Documentation/devicetree/bindings/hwinfo/ti,k3-socinfo.yaml
```yaml
# SPDX-License-Identifier: (GPL-2.0-only OR BSD-2-Clause)
%YAML 1.2
---
$id: http://devicetree.org/schemas/hwinfo/ti,k3-socinfo.yaml#
$schema: http://devicetree.org/meta-schemas/core.yaml#

title: Texas Instruments K3 Multicore SoC platforms chipid module

maintainers:
  - Tero Kristo <t-kristo@ti.com>
  - Nishanth Menon <nm@ti.com>

description: |
  Texas Instruments (ARM64) K3 Multicore SoC platforms chipid module is
  represented by CTRLMMR_xxx_JTAGID register which contains information about
  SoC id and revision.

  On some SoCs like AM62P, the silicon revision is determined by reading
  alternative registers via NVMEM cells.

properties:
  $nodename:
    pattern: "^chipid(@[0-9a-f]+)?$"

  compatible:
    items:
      - enum:
          - ti,am654-chipid
          - ti,tda54-chipid

  reg:
    maxItems: 1

  ti,syscon-chipid:
    $ref: /schemas/types.yaml#/definitions/phandle-array
    description:
      Phandle to the syscon covering the JTAGID register, and the byte
      offset of the JTAGID register within that syscon's address range.
    items:
      - items:
          - description: Phandle to syscon covering the JTAGID register
          - description: Offset of the JTAGID register

  nvmem-cells:
    items:
      - description: Alternate silicon revision register

  nvmem-cell-names:
    items:
      - const: gpsw1

required:
  - compatible

additionalProperties: false

allOf:
  - if:
      properties:
        compatible:
          contains:
            const: ti,tda54-chipid
    then:
      properties:
        reg: false
      required:
        - ti,syscon-chipid
    else:
      properties:
        ti,syscon-chipid: false
      required:
        - reg

examples:
  - |
    chipid@43000014 {
        compatible = "ti,am654-chipid";
        reg = <0x43000014 0x4>;
    };

  - |
    chipid {
        compatible = "ti,tda54-chipid";
        ti,syscon-chipid = <&scm_conf 0x14>;
    };
```

## Documentation/devicetree/bindings/mfd/ti,tda54-scm-conf.yaml
```yaml
# SPDX-License-Identifier: (GPL-2.0-only OR BSD-2-Clause)
%YAML 1.2
---
$id: http://devicetree.org/schemas/mfd/ti,tda54-scm-conf.yaml#
$schema: http://devicetree.org/meta-schemas/core.yaml#

title: Texas Instruments TDA54 SoC System Control Module Configuration registers

maintainers:
  - Aniket Limaye <a-limaye@ti.com>
  - Moteen Shah <m-shah@ti.com>

description: |
  The TDA54 SoC's MCU domain exposes a System Control Module configuration
  register region (scm_conf) containing miscellaneous control and status
  registers for MCU domain peripherals, including the JTAGID/device
  identification registers, boot configuration and status registers, and
  device feature registers.

  A subset of these registers is write-protected by a proxy/claim scheme:
  each register is mirrored across 8 proxy regions, and a host must unlock
  via LOCK_KICK and claim a register through its CLAIM register before
  writing through that proxy. For example:
  Proxy0's CLAIM0 register sits at offset 0x3100, while the same register
  mirrored at ProxyN sits at N * 0x4000 + 0x3100.

  Each of the 8 proxy regions also has its own fault status and
  interrupt registers, so handling a fault at runtime requires knowing both
  the proxy a consumer accesses through and that proxy's interrupt. The
  previous-stage bootloader claims the proxies Linux needs before handoff.

properties:
  compatible:
    items:
      - const: ti,tda54-scm-conf
      - const: syscon

  reg:
    maxItems: 1

  ti,proxy-id:
    $ref: /schemas/types.yaml#/definitions/uint32
    minimum: 0
    maximum: 7
    description:
      Proxy region (0-7) through which this node's clients access
      claimable registers and their fault status registers.

  ti,lock-offset:
    $ref: /schemas/types.yaml#/definitions/uint32
    description:
      offset of lock register within scm conf block.

  ti,intr-offset:
    $ref: /schemas/types.yaml#/definitions/uint32
    description:
      offset of interrupt register within scm conf block.

  ti,fault-offset:
    $ref: /schemas/types.yaml#/definitions/uint32
    description:
      offset of fault register within scm conf block.

  ti,claim-offset:
    $ref: /schemas/types.yaml#/definitions/uint32
    description:
      offset of claim register within scm conf block.

  ti,claim-status-offset:
    $ref: /schemas/types.yaml#/definitions/uint32
    description:
      offset of claim status register within scm conf block.

  interrupts:
    maxItems: 1
    description:
      Fault interrupt line for the proxy region given in ti,proxy-id.

required:
  - compatible
  - reg
  - interrupts
  - ti,proxy-id
  - ti,lock-offset
  - ti,fault-offset
  - ti,claim-offset
  - ti,claim-status-offset

additionalProperties: false

examples:

  - |
    #include <dt-bindings/interrupt-controller/arm-gic.h>
    scm_conf1: syscon@5e800000 {
        compatible = "ti,tda54-scm-conf", "syscon";
        reg = <0x5e800000 0x20000>;
        interrupts = <GIC_SPI 96 IRQ_TYPE_LEVEL_HIGH>;
        ti,proxy-id = <0>;
        ti,lock-offset = <0x3008>;
        ti,fault-offset= <0x3024>;
        ti,claim-offset = <0x3100>;
        ti,claim-status-offset = <0x3300>;
    };

...
```
