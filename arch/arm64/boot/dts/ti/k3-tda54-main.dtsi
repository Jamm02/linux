// SPDX-License-Identifier: GPL-2.0-only OR MIT
/*
 * Device Tree Source for TDA54 SoC Family Main Domain peripherals
 *
 * Copyright (C) 2026 Texas Instruments Incorporated - https://www.ti.com/
 */

&cbass_main {
	oc_msram: sram@23800000 {
		compatible = "mmio-sram";
		reg = <0x0 0x23800000 0x0 0x600000>;
		ranges = <0x0 0x0 0x23800000 0x600000>;
		#address-cells = <1>;
		#size-cells = <1>;
	};
};
